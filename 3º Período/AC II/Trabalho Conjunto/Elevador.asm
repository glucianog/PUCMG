#INCLUDE <P16F628A.INC>		;ARQUIVO PADRÃO MICROCHIP PARA 16F628A
__CONFIG H'3F10'

#DEFINE	BANK0	BCF STATUS,RP0	;SETA BANK 0 DE MEMÓRIA

#DEFINE	BANK1	BSF STATUS,RP0	;SETA BANK 1 DE MAMÓRIA

	CBLOCK	0x20	;ENDEREÇO INICIAL DA MEMÓRIA DE USUÁRIO
	CONTADOR1
	CONTADOR2
	CONTADOR3
	CONTADORTERREO
	CONTADOR1A
	CONTADOR2A
	CONTADOR3A
	CONT1
	CONT2
	CONT3




	ENDC			;FIM DO BLOCO DE MEMÓRIA		

#DEFINE	BOTAO	PORTA,2	;PORTA DO BOTÃO
					; 0 -> PRESSIONADO
					; 1 -> LIBERADO

#DEFINE	LED1	PORTB,0	;PORTA DO LED
				; 0 -> APAGADO
				; 1 -> ACESO

#DEFINE	LED2	PORTB,1	;PORTA DO LED
				; 0 -> APAGADO
				; 1 -> ACESO

#DEFINE	LED3	PORTB,2	;PORTA DO LED
				; 0 -> APAGADO
				; 1 -> ACESO

#DEFINE	LED4	PORTB,3	;PORTA DO LED
				; 0 -> APAGADO
				; 1 -> ACESO


	ORG	0x00		;ENDEREÇO INICIAL DE PROCESSAMENTO
	GOTO	INICIO
	
INICIO
	CLRF	PORTA		;LIMPA O PORTA
	CLRF	PORTB		;LIMPA O PORTB
	BANK1			;ALTERA PARA O BANCO 1
	MOVLW	B'00000100'
	MOVWF	TRISA		;DEFINE RA2 COMO ENTRADA E DEMAIS COMO SAÍDAS
	MOVLW	B'00000000'
	MOVWF	TRISB		;DEFINE TODO O PORTB COMO SAÍDA
	MOVLW	B'00000000'
	MOVWF	INTCON		;TODAS AS INTERRUPÇÕES DESLIGADAS
	BANK0			;RETORNA PARA O BANCO 0
	MOVLW	B'00000111'
	MOVWF	CMCON		;DEFINE O MODO DO COMPARADOR ANALÓGICO

MAIN
		


	BTFSS	BOTAO		  ;BOTÃO ESTÁ PRESSIONADO?
	GOTO	BOTAO_PRES	  ;SIM, ENTÃO TRATA BOTÃO PRESSIONADO

	; ================  SOBE ================ ;
	; ================ TÉRREO ================ ;

	BCF LED2			;APAGA O LED2
	BSF LED1			;ACENDE O LED1 - TÉRREO
	CALL ATRASOTERREO	;ATRASO DE 2 SEGUNDOS - TÉRREO + TESTE	

	; ================ 1 ANDAR ================ ;

	BCF LED1			;APAGA O LED DO TERREO
	BSF LED2			;ACENDER O LED DO 2 ANDAR
	CALL ATRASO1A	;ATRASO DE 2 SEGUNDOS  - 1 ANDAR + TESTE
	CALL ATRASO1A	;ATRASO DE 4 SEGUNDOS  - 1 ANDAR + TESTE

	; ================ 2 ANDAR ================ ;	

	BCF LED2			;APAGA O LED2
	BSF LED3			;ACENDE O LED 3	
	CALL ATRASO2A	;ATRASO DE 2 SEGUNDOS - 2 ANDAR + TESTE
	CALL ATRASO2A	;ATRASO DE 2 SEGUNDOS - 2 ANDAR + TESTE
	CALL ATRASO2A	;ATRASO DE 2 SEGUNDOS - 2 ANDAR + TESTE

	
	; ================ 3 ANDAR ================ ;

	BCF LED3			;APAGA LED 3
	BSF LED4			;ACENDE LED 4	
	CALL ATRASO3A	;ATRASO DE 2 SEGUNDOS - 3 ANDAR + TESTE
	CALL ATRASO3A	;ATRASO DE 2 SEGUNDOS - 3 ANDAR + TESTE
	CALL ATRASO3A	;ATRASO DE 2 SEGUNDOS - 3 ANDAR + TESTE
	CALL ATRASO3A	;ATRASO DE 2 SEGUNDOS - 3 ANDAR + TESTE


	; ================  DESCE ================ ;
	; ================ 2 ANDAR ================ ;

	BCF LED4			;APAGA LED 4
	BSF LED3			;ACENDE LED 3
	CALL ATRASO2A	;ATRASO DE 2 SEGUNDOS - 2 ANDAR + TESTE
	CALL ATRASO2A	;ATRASO DE 2 SEGUNDOS - 2 ANDAR + TESTE
	CALL ATRASO2A	;ATRASO DE 2 SEGUNDOS - 2 ANDAR + TESTE

	; ================ 1 ANDAR ================ ;

	BCF LED3			;APAGA LED 3
	BSF LED2			;ACENDE LED 2	
	CALL ATRASO1A	;ATRASO DE 2 SEGUNDOS  - 1 ANDAR + TESTE
	CALL ATRASO1A	;ATRASO DE 2 SEGUNDOS  - 1 ANDAR + TESTE

	GOTO MAIN


BOTAO_PRES ;ATRASO 10 SEGUNDOS NO TERRO - BOTÃO
	
	BCF LED2			;APAGA O LED2
	BSF LED1			;ACENDE O LED1 - TÉRREO
	
	CALL ATRASODELAY	;ATRASO DE 2 SEGUNDOS - BOTÃO BOMBEIROS
	CALL ATRASODELAY	;ATRASO DE 2 SEGUNDOS - BOTÃO BOMBEIROS
	CALL ATRASODELAY	;ATRASO DE 2 SEGUNDOS - BOTÃO BOMBEIROS
	CALL ATRASODELAY	;ATRASO DE 2 SEGUNDOS - BOTÃO BOMBEIROS
	CALL ATRASODELAY	;ATRASO DE 2 SEGUNDOS - BOTÃO BOMBEIROS

	GOTO MAIN

BOTAO_PRES1 ; ATRASO 2 SGUNDOS NO 1 ANDAR - SUBIDA	

	BCF LED3			;APAGA O LED3  - 2 ANDAR
	BSF LED2			;ACENDE O LED2 - 1 ANDAR
	CALL ATRASODELAY	;ATRASO DE 2 SEGUNDOS - BOTÃO BOMBEIROS
	GOTO BOTAO_PRES

BOTAO_PRES2 ; ATRASO 2 SGUNDOS NO 2 ANDAR - SUBIDA
	BCF LED4			;APAGA O LED4  - 3 ANDAR
	BSF LED3			;ACENDE O LED3 - 2 ANDAR
	CALL ATRASODELAY	;ATRASO DE 2 SEGUNDOS - BOTÃO BOMBEIROS
	GOTO BOTAO_PRES1

BOTAO_PRES3	; ATRASO 2 SGUNDOS NO 3 ANDAR - SUBIDA
	BCF LED3			;APAGA O LED3  - 2 ANDAR
	BSF LED4			;ACENDE O LED4 - 3 ANDAR
	CALL ATRASODELAY	;ATRASO DE 2 SEGUNDOS - BOTÃO BOMBEIROS
	GOTO BOTAO_PRES2

; ====================================================================== ; 
; ============================ ATRASOS ================================= ;
; ====================================================================== ; 

; ================ TESTE TERREO ================ ;

ATRASOTERREO
	MOVLW 50  ; 25 VERIFICAÇÕES POR SEGUNDO ( 50 )
	MOVWF CONTADORTERREO

	DELAYT
		CALL	ATRASO
		BTFSS	BOTAO			; BOTÃO FOI PRESSIONADO?
		GOTO	BOTAO_PRES		; SIM, ATIVE O BOTÃO DE BOMBEIROS DO TERREO
	DECFSZ	CONTADORTERREO
	GOTO	DELAYT
	RETURN
 
	
; ================ TESTE 1 ANDAR ================ ;

ATRASO1A
	MOVLW 50	; 25 VERIFICAÇÕES POR SEGUNDO ( 100 )
	MOVWF CONTADOR1A

	DELAY1A
		CALL	ATRASO			
		BTFSS	BOTAO			; BOTÃO FOI PRESSIONADO?
		GOTO	BOTAO_PRES1		; SIM, ATIVE O BOTÃO DE BOMBEIROS DO 1 ANDAR
	DECFSZ	CONTADOR1A
	GOTO	DELAY1A
	RETURN

; ================ TESTE 2 ANDAR ================ ;

ATRASO2A
	MOVLW 50	; 25 VERIFICAÇÕES POR SEGUNDO ( 150 )		
	MOVWF CONTADOR2A

	DELAY2A
		CALL	ATRASO	
		BTFSS	BOTAO			; BOTÃO FOI PRESSIONADO?
		GOTO	BOTAO_PRES2		; SIM, ATIVE O BOTÃO DE BOMBEIROS DO 2 ANDAR
	DECFSZ	CONTADOR2A
	GOTO	DELAY2A

	RETURN

; ================ TESTE 3 ANDAR ================ ;

ATRASO3A
	MOVLW 50		;200
	MOVWF CONTADOR3A

	DELAY3A
		CALL	ATRASO
		BTFSS	BOTAO			; BOTÃO FOI PRESSIONADO?
		GOTO	BOTAO_PRES3		; SIM, ATIVE O BOTÃO DE BOMBEIROS DO 3 ANDAR
	DECFSZ	CONTADOR3A
	GOTO	DELAY3A

	RETURN



; ============================ ATRASO DE TESTES ================================= ;
ATRASO		;ATRASO DE 0,0025 SEGUNDOS TERREO	
	MOVLW	233			;233
	MOVWF	CONTADOR1	
ATRASO1		
	MOVLW 2				;2
	MOVWF	CONTADOR2
	ATRASO2
		MOVLW 250		;250
		MOVWF	CONTADOR3
		ATRASO3
			DECFSZ	CONTADOR3	
			GOTO	ATRASO3
		DECFSZ	CONTADOR2	
		GOTO	ATRASO2
	DECFSZ	CONTADOR1	
	GOTO	ATRASO1
	RETURN


; ============================ ATRASO 2 SEGUNDOS ================================= ;

ATRASODELAY		;ATRASO DE 2 SEGUNDOS TERREO	
	MOVLW	237			;233
	MOVWF	CONT1	
ATRASODELAY1		
	MOVLW 90			;2
	MOVWF	CONT2
	ATRASODELAY2
		MOVLW 253		;250
		MOVWF	CONT3
		ATRASODELAY3
			DECFSZ	CONT3	
			GOTO	ATRASODELAY3
		DECFSZ	CONT2	
		GOTO	ATRASODELAY2
	DECFSZ	CONT1	
	GOTO	ATRASODELAY1
	RETURN



END			;OBRIGATÓRIO
