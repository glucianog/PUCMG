#INCLUDE <P16F628A.INC>		;ARQUIVO PADRÃO MICROCHIP PARA 16F628A
__CONFIG H'3F10'

#DEFINE	BANK0	BCF STATUS,RP0	;SETA BANK 0 DE MEMÓRIA

#DEFINE	BANK1	BSF STATUS,RP0	;SETA BANK 1 DE MAMÓRIA

	CBLOCK	0x20	;ENDEREÇO INICIAL DA MEMÓRIA DE USUÁRIO
	ENDC			;FIM DO BLOCO DE MEMÓRIA		

#DEFINE	BOTAO	PORTA,2	;PORTA DO BOTÃO
					; 0 -> PRESSIONADO
					; 1 -> LIBERADO

#DEFINE	LED1	PORTB,0	;PORTA DO LED
				; 0 -> APAGADO
				; 1 -> ACESO

#DEFINE	LED2	PORTB,1	;PORTA DO LED
				; 0 -> APAGADO
				; 1 -> ACESO

	ORG	0x00		;ENDEREÇO INICIAL DE PROCESSAMENTO
	GOTO	INICIO
	
INICIO
	CLRF	PORTA		;LIMPA O PORTA
	CLRF	PORTB		;LIMPA O PORTB
	BANK1			;ALTERA PARA O BANCO 1
	MOVLW	B'00000100'
	MOVWF	TRISA		;DEFINE RA1 COMO ENTRADA E DEMAIS COMO SAÍDAS
	MOVLW	B'00000000'
	MOVWF	TRISB		;DEFINE TODO O PORTB COMO SAÍDA
	MOVLW	B'00000000'
	MOVWF	INTCON		;TODAS AS INTERRUPÇÕES DESLIGADAS
	BANK0			;RETORNA PARA O BANCO 0
	MOVLW	B'00000111'
	MOVWF	CMCON		;DEFINE O MODO DO COMPARADOR ANALÓGICO

MAIN

	BTFSC	BOTAO		;O BOTÃO ESTÁ PRESSIONADO?
	GOTO	MAIN            ; NAO, ESPERA SER PRESSIONADO
	GOTO	BOTAO_PRES1	;SIM, ENTÃO TRATA BOTÃO PRESSIONADO

BOTAO_PRES1
	BTFSS	BOTAO		;O BOTÃO AINDA ESTÁ PRESSIONADO?
	GOTO	BOTAO_PRES1	;SIM, ENTÃO ESPERA DESLIGAR
	BSF	LED1		;NAO, ACENDE O LED1
	BCF	LED2		;APAGA O LED2
        GOTO TESTA2

TESTA2
	BTFSC	BOTAO		;O BOTÃO ESTÁ PRESSIONADO?
	GOTO	TESTA2          ; NÃO, ESPERA SER PRESSIONADO
	GOTO	BOTAO_PRES2	;SIM, ENTÃO TRATA BOTÃO PRESSIONADO

BOTAO_PRES2
	BTFSS	BOTAO		;O BOTÃO AINDA ESTÁ PRESSIONADO?
	GOTO	BOTAO_PRES2	;SIM, ENTÃO ESPERA DESLIGAR
	BSF	LED2		;NAO, ACENDE O LED2
	BCF	LED1		;APAGA O LED1
	GOTO 	MAIN		;RETORNA AO LOOP PRINCIPAL






	END			;OBRIGATÓRIO


