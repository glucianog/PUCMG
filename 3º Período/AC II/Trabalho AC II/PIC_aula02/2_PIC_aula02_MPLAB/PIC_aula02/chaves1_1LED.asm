#INCLUDE <P16F628A.INC>		;ARQUIVO PADRÃO MICROCHIP PARA 16F628A
__CONFIG H'3F10'

#DEFINE	BANK0	BCF STATUS,RP0	;SETA BANK 0 DE MEMÓRIA

#DEFINE	BANK1	BSF STATUS,RP0	;SETA BANK 1 DE MAMÓRIA

	CBLOCK	0x20	;ENDEREÇO INICIAL DA MEMÓRIA DE USUÁRIO
	CONTADOR1	
	ENDC			;FIM DO BLOCO DE MEMÓRIA		

#DEFINE	BOTAO	PORTA,2	;PORTA DO BOTÃO
					; 0 -> PRESSIONADO
					; 1 -> LIBERADO

#DEFINE	LED	PORTB,0	;PORTA DO LED
				; 0 -> APAGADO
				; 1 -> ACESO
	ORG	0x00		;ENDEREÇO INICIAL DE PROCESSAMENTO
	GOTO	INICIO
	
INICIO
	CLRF	PORTA		;LIMPA O PORTA
	CLRF	PORTB		;LIMPA O PORTB
	BANK1			;ALTERA PARA O BANCO 1
	MOVLW	B'00000100'
	MOVWF	TRISA		;DEFINE RA2 COMO ENTRADA E DEMAIS COMO SAÍDAS
	MOVLW	B'00000000'
	MOVWF	TRISB		;DEFINE TODO O PORTB COMO SAÍDA
	MOVLW	B'00000000'
	MOVWF	INTCON		;TODAS AS INTERRUPÇÕES DESLIGADAS
	BANK0			;RETORNA PARA O BANCO 0
	MOVLW	B'00000111'
	MOVWF	CMCON		;DEFINE O MODO DO COMPARADOR ANALÓGICO

MAIN

	BTFSC	BOTAO		;O BOTÃO ESTÁ PRESSIONADO?
	GOTO	BOTAO_LIB	;NÃO, ENTÃO TRATA BOTÃO LIBERADO
	GOTO	BOTAO_PRES	;SIM, ENTÃO TRATA BOTÃO PRESSIONADO

BOTAO_LIB
	BCF	LED		;APAGA O LED
	GOTO 	MAIN		;RETORNA AO LOOP PRINCIPAL

BOTAO_PRES
	BSF	LED		;ACENDE O LED
	GOTO 	MAIN		;RETORNA AO LOOP PRINCIPAL


	END			;OBRIGATÓRIO


