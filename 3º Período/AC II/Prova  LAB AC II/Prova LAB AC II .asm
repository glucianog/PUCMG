;************** AULA 01 - PROGRAMA PARA PISCAR LED *****************
LIST   P=PIC16F628A
RADIX DEC	
#INCLUDE <P16F628A.INC>
	__CONFIG _INTRC_OSC_NOCLKOUT & _WDT_OFF & _PWRTE_ON & _BODEN_OFF & _LVP_OFF & _CP_OFF & _MCLRE_OFF & _DATA_CP_OFF 
	;ou __CONFIG H'3F10'

	CBLOCK	0x20	;ENDEREÇO INICIAL DA MEMÓRIA DE
					;USUÁRIO
	CONTADOR1
	CONTADOR2
	CONTADOR3
	CONTADOR4
	ENDC			;FIM DO BLOCO DE MEMÓRIA		
	
	ORG	0x00		;ENDEREÇO INICIAL DE PROCESSAMENTO
	GOTO	INICIO
		
INICIO
	CLRF	PORTA		;LIMPA O PORTA
	CLRF	PORTB		;LIMPA O PORTB
	BSF STATUS, RP0
	CLRF TRISB
	BCF STATUS, RP0

REPETE
	BSF PORTB, 1
	CALL ATRASO
	BCF PORTB, 1
	CALL ATRASO
	GOTO REPETE



LOOP
	DECFSZ	CONTADOR4
	GOTO	LOOP
	RETURN

ATRASO	
	MOVLW 6
	MOVWF CONTADOR4
 	CALL LOOP		
	MOVLW	39
	MOVWF	CONTADOR1	
ATRASO1	
	CALL 	FOR1				
	DECFSZ	CONTADOR1	
	GOTO	ATRASO1	
	NOP				
	RETURN	

FOR1
	MOVLW	103
	MOVWF	CONTADOR2
ATRASO2	
	CALL 	FOR2				
	DECFSZ	CONTADOR2	
	GOTO	ATRASO2
	NOP	
	NOP
	NOP

	RETURN			

FOR2
	MOVLW	106
	MOVWF	CONTADOR3
ATRASO3					
	DECFSZ	CONTADOR3	
	GOTO	ATRASO3	
	
	RETURN




END